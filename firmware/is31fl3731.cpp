//=============================================================================================
// is31fl3731.cpp - Implents a two-character display driver for the IS31FL3731 Led Matrix
//=============================================================================================
#include <string.h>
#include <avr/pgmspace.h>
#include "is31fl3731.h"
#include "globals.h"
#include "i2c.h"


#define FRAME_SELECT_REG  0xFD
#define CONFIG_FRAME      0x0B
#define PWM_BASE_REG      0x24
#define LED_CTRL_BASE_REG 0x00
#define SHUTDOWN_REG      0x0A

const unsigned char font[] PROGMEM = 
{
    0x00, 0x00, 0x00, 0x00, 0x00, 0x00, 0x00,      // ASCII 0
    0x0E, 0x1F, 0x15, 0x1F, 0x1B, 0x11, 0x0E,      // ASCII 1
    0x0E, 0x1F, 0x15, 0x1F, 0x11, 0x1B, 0x0E,      // ASCII 2
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    0x00, 0x00, 0x00, 0x00, 0x00, 0x00, 0x00       // ASCII 255
};

//=============================================================================================
// Lookup table that maps an LED index to a PWM register.  This table was built with the 
// code below it
//=============================================================================================
static const unsigned char pwm_reg[] PROGMEM = 
{
    43, 59, 75, 91, 107, 123, 139, 155, 156, 140, 124, 108, 92, 76, 60, 44,
    42, 58, 74, 90, 106, 122, 138, 154, 157, 141, 125, 109, 93, 77, 61, 45,
    41, 57, 73, 89, 105, 121, 137, 153, 158, 142, 126, 110, 94, 78, 62, 46,
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    36, 52, 68, 84, 100, 116, 132, 148, 163, 147, 131, 115, 99, 83, 67, 51,
};
//=============================================================================================
/* 
static void IS31FL3731::map_led_to_pwm_reg()
{
    int row, col;
    int starting_reg_l = MAX_ROWS - 1;
    int starting_reg_r = MAX_ROWS + 16*7;
    int index = 0;
    
    // Loop through every row the chip supports
    for (row = 0; row < MAX_ROWS; ++row)
    {
        // For the first 8 columns, register numbers are ascending
        for (col=0; col< MAX_COLS/2; ++col)
        {
            pwm_reg[index++] = PWM_BASE_REG + starting_reg_l + col*16;  
        }

        // For the next 8 columns, register numbers are descending
        for (col=0; col<MAX_COLS/2; ++col)
        {
            pwm_reg[index++] = PWM_BASE_REG + starting_reg_r - col*16;
        }

        --starting_reg_l;
        ++starting_reg_r;
    }
}
//=============================================================================================
*/

//=============================================================================================
// transmit() - Transmits data to the device via I2C
//=============================================================================================
void IS31FL3731::transmit(const uint8_t* data, size_t length)
{
    if (twi_writeTo(m_i2c_address, data, length, true, true) != 0)
        System.error_byte |= LED_DRV_ERR;
}
//=============================================================================================


//=============================================================================================
// write_reg() - Writes an 8-bit value to an 8-bit address on the device
//=============================================================================================
void IS31FL3731::write_reg(unsigned char address, unsigned char value)
{
    unsigned char buffer[2] = { address, value };
    transmit(buffer, 2);
}
//=============================================================================================



//=============================================================================================
// display_image() - Transmits the PWM values for our entire bitmap to the device
//=============================================================================================
void IS31FL3731::display_image()
{
    // This holds the address of a PWM register plus 1 PWM value
    unsigned char cmd[2];

    // Find out how many columns of LEDs are missing from the right-edge
    const int missing_led_cols = MAX_COLS - PHYS_COLS;

    // Create a bitmask with a 1 in either the left-most or right-most bit 
    // that corresponds to a physical LED
    uint16_t initial_mask = (m_orientation) ?  (1 << missing_led_cols) : (1 << 15);

    // Loop through each row of the display from top to bottom
    for (int row = 0; row < PHYS_ROWS; ++row)
    {
        // Find the index of the first LED in this row
        int led_index = row * MAX_COLS;

        // Fetch the LED-is-on bits for the bitmap-row we care about
        uint16_t row_bits = (m_orientation) ?  m_bitmap[PHYS_ROWS - 1 - row] : m_bitmap[row];

        // The mask for this row starts with a 1 in either the left-most or right-most bit
        // that coreresponds to a physical LED
        uint16_t mask = initial_mask;

        // Loop through each column, turning a bit into a PWM value
        for (int col = 0; col < PHYS_COLS; ++col)
        {
            // Find out which PWM register corresponds to this LED
            cmd[0] = pgm_read_byte_near(pwm_reg + led_index++);

            // Determine whether we're turning this LED on or off
            cmd[1] = (row_bits & mask) ? m_brightness : 0;
            
            // Transmit the PWM value to the register
            transmit(cmd, 2);

            // And shift to the next (or previous) LED
            if (m_orientation)
                mask <<= 1;
            else
                mask >>= 1;
        }

    }
}
//=============================================================================================



//=============================================================================================
// init() - Call once at startup
//=============================================================================================
void IS31FL3731::init(int i2c_address, unsigned char brightness)
{
    // Save the I2C address for future use
    m_i2c_address = i2c_address;

    // Save the PWM value we want to use to turn an LED on
    m_brightness = brightness;

    // We start out in right-side-up orientation
    m_orientation = true;

    // Clear the bitmap.  This is the equivalent of a "clear the screen"
    memset(m_bitmap, 0, sizeof m_bitmap);

    // Select frame #9, which is actually the control registers
    write_reg(FRAME_SELECT_REG, CONFIG_FRAME);

    // Ensure that the chip isn't in shutdown mode
    write_reg(SHUTDOWN_REG, 1);

    // This selects "picture mode" with frame #0 the frame to be displayed
    write_reg(0,0);

    // Select frame #0
    write_reg(FRAME_SELECT_REG, 0);

    // Send the PWM equivalent of our bitmap to the device
    display_image();

    // This writes a 1-bit to the "enable" bit for every LED
    unsigned char enable_cmd[] =
    {
        LED_CTRL_BASE_REG,
        0xFF, 0xFF, 0xFF, 0xFF, 0xFF, 0xFF, 0xFF, 0xFF, 0xFF,
        0xFF, 0xFF, 0xFF, 0xFF, 0xFF, 0xFF, 0xFF, 0xFF, 0xFF
    };

    // Send the "enable all LEDs" command
    transmit(enable_cmd, sizeof enable_cmd);
}
//=============================================================================================



//=============================================================================================
// reinit() - Reinitialize the display
//=============================================================================================
void IS31FL3731::reinit()
{
    init(m_i2c_address, m_brightness);
}
//=============================================================================================

//=============================================================================================
// fill() - Turns on every pixel in the display
//=============================================================================================
void IS31FL3731::fill()
{
    // Fill every bit of the bitmap so that every LED turns on
    memset(m_bitmap, 0xFF, sizeof m_bitmap);

    // And display the image
    display_image();
}
//=============================================================================================




//=============================================================================================
// set_brightness() - Define the PWM value of an "on" pixel and optionally update the display
//=============================================================================================
void IS31FL3731::set_brightness(unsigned char brightness, bool update_image)
{
    // Save the PWM value we want to use for an "on" pixel
    m_brightness = brightness;

    // And optionally update the display with this new brightness
    if (update_image) display_image();
}
//=============================================================================================


//=============================================================================================
// set_orientation() - Sets the orientation of the display and optionally redisplays the
//                     current image
//=============================================================================================
void IS31FL3731::set_orientation(bool orientation, bool update_image)
{
    // Save the specified orientation for future reference
    m_orientation = orientation;
    
    // If the caller wants us to update the image, make it so
    if (update_image) display_image();
}
//=============================================================================================



//=============================================================================================
// vertical_bar() - Draws a vertical bar at the specified column
//=============================================================================================
void IS31FL3731::vertical_bar(int column, bool update_image)
{
    // Ensure that the column number the caller gave us physically exists
    if (column < 0 || column >= PHYS_COLS) return;

    // Turn the column into a bit-mask
    int mask = 1 << (15 - column);

    // Turn that bit on in each row
    for (int row = 0; row < PHYS_ROWS; ++row) m_bitmap[row] |= mask;

    // And optionally update the display with this new vertical bar
    if (update_image) display_image();
}
//=============================================================================================



//=============================================================================================
// print() - Merges the bitmap of a character into our display bitmap.
// 
// This does not transmit the bitmap to the device
//=============================================================================================
void IS31FL3731::print(int display_row, int display_col, uint8_t c)
{
    // These are the dimensions of a character in our font
    const int CHAR_COLS = 5;
    const int CHAR_ROWS = 7;

    // Get the index in the font table where our 5x7 character begins
    int font_index = c * CHAR_ROWS;

    // Determine which bit number the left-most bit of the 5 bit-wide character should reside in
    int shift = (PHYS_COLS - CHAR_COLS + 1) - display_col;

    // Loop through each row of the character...
    for (int char_row = 0; char_row < CHAR_ROWS; ++char_row)
    {
        // If it's off the end of the display, we're done
        if (display_row >= MAX_ROWS) break;
        
        // Fetch the bits for this row of the character
        uint16_t bits = pgm_read_byte_near(font + font_index++);

        // And merge those bits into our display bitmap
        m_bitmap[display_row++] |= (bits << shift);
    }
}
//=============================================================================================



//=============================================================================================
// print() - Displays two characters on the screen
//=============================================================================================
void IS31FL3731::print(char c1, char c2)
{
    // Clear all bits to off
    memset(m_bitmap, 0, sizeof m_bitmap);

    // Print either 1 or 2 characters
    if (c2 == 0)
        print(0, 5, (unsigned char)c1);
    else
    {
        print(0, 2, (unsigned char)c1);
        print(0, 8, (unsigned char)c2);
    }

    // Transmit our bitmap to the device
    display_image();
}
//=============================================================================================


//=============================================================================================
// print() - Print an integer value between -9 and 99
//=============================================================================================
void IS31FL3731::print(int value)
{
    char c1 = '*', c2 = '*';

    // If it's a negative one digit number...
    if (value >= -9 && value <= -1)
    {
        c1 = '-';
        c2 = '0' - value;
    }

    // If it's a positive single-digit number...
    else if (value >= 0 && value <= 9)
    {
        c1 = '0' + value;
        c2 = 0;
    }

    // If it's a two digit number...
    if (value >= 10 && value <= 99)
    {
        c1 = '0' + value / 10;
        c2 = '0' + value % 10;
    }

    // And display the two characters
    print(c1, c2);
}
//=============================================================================================


 

//=============================================================================================
// print() - Print a rounded floating point value between -9 and 99
//=============================================================================================
void IS31FL3731::print(double value)
{
    print((int)(value + .5));
}
//=============================================================================================




//=============================================================================================
// print() - Print a 2 character string
//=============================================================================================
void IS31FL3731::print(const char* str)
{
    char c1 = str[0];
    char c2 = str[1];
    if (c1 == 0) c2 = 0;
    print(c1, c2);
}
//=============================================================================================
